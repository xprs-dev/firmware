## common/geogram_xprs/Kconfig
```kconfig
menu "XPRS station storage"

config SDCARD_MAX_FILES
    int "How many files may be open on the card at once"
    default 5
    range 2 10
    help
        With CONFIG_FATFS_SECTOR_4096 and CONFIG_FATFS_PER_FILE_CACHE --
        which both boards use -- every open FILE holds a 4 KB sector cache,
        so this number costs four kilobytes of heap each and is one of the
        largest single allocations either board makes.

        Five is right for the M5Stack, whose store keeps three files open
        while a query opens two more. The T-Dongle keeps the index segment
        and the store-and-forward spool open and reads one at a time, so
        three fits it and hands eight kilobytes back to a heap that has
        none to spare. docs/esp32.md records what happened the last time
        this number was raised "to be safe".
endmenu
```

## common/geogram_xprsble/Kconfig
```kconfig
menu "XPRS over BLE5"

config XPRSBLE_BACKEND_TINYNIMBLE
    bool "Use tinynimble instead of the NimBLE host"
    default n
    help
        Speak to the BLE controller directly over HCI rather than through
        NimBLE. The radio behaviour is identical -- one non-connectable
        extended advertising set at 160 ms and one passive extended scan at
        0x0060/0x0050 -- and the two have been shown hearing each other on the
        air in both directions.

        Measured on a T-Deck, same board and same test, only the stack changed:
        21 KB less flash, 3.3 KB less static RAM, and 19,108 bytes less heap at
        BLE init, leaving 22,300 bytes more free at steady state.

        The catch: tinynimble has no GATT and no connections. A board that must
        serve a GATT characteristic to phones needs the NimBLE host and cannot
        use this. Everything that only broadcasts and listens can.

        Turn CONFIG_BT_NIMBLE_ENABLED off as well, or the host is still linked
        and the flash saving does not appear.

endmenu
```

## common/xprs_bearer_lora/Kconfig
```kconfig
menu "XPRS LoRa"

config XPRS_LORA
    bool "LoRa radio code (the SX1262 bearer, Meshtastic and MeshCore)"
    default y
    help
        Off on a board with no LoRa radio: the bearer is built as stubs
        (xprslora_stub.c) and the SX1262, Meshtastic and MeshCore code is
        not linked, about 44 KB of flash on the e-paper board.

endmenu
```

## common/xprs_bearer_rns/Kconfig
```kconfig
menu "XPRS over Reticulum"

config XPRS_BEARER_RNS
    bool "Reticulum bearer for the XPRS archiver"
    default n
    help
        Puts this station's archiver on Reticulum: a TCP uplink to a hub or
        to a nearby Aurora node, XPRS wires carried as signed wapp-datagram
        announces (tag "xprs"), and inbound ones fed to the same funnel every
        radio feeds. Costs roughly one task stack, one TCP connection's
        windows and the Ed25519 arithmetic -- leave it off on boards without
        the memory; everything compiles to no-ops when disabled.

endmenu
```

## common/xprs_bearer_wifi8/Kconfig
```kconfig
menu "XPRS over XPRS-WiFi (long range)"

config XPRS_WIFI8
    bool "XPRS-WiFi bearer (the xwifi library)"
    depends on IDF_TARGET_ESP32C3 || IDF_TARGET_ESP32S3
    default n
    help
        Carries XPRS packets over XPRS-WiFi, the long-range chirp-spread-
        spectrum waveform of the xwifi library, on the chip's own 2.4 GHz
        radio -- about 24 dB more link budget than the ESP-NOW bearer, bought
        with seconds of airtime per packet instead of a single frame.

        The radio is shared with the ordinary 802.11 stack (the walk-up
        hotspot and the local-WiFi uplink) by time-slicing: 802.11 most of the
        time, borrowed for short XPRS-WiFi slots. The AP and the uplink hiccup
        for each slot, so the slot length and cadence (xprswifi8_cfg_t) are a
        tuning knob, not a fixed number.

        Offered only on the ESP32-C3 and ESP32-S3, the chips xwifi has a port
        for. On a C3 running the full station the 128 KiB I/Q bank the port
        reserves may not fit beside everything else -- measure the free heap
        on a C3 build before relying on it. Everything compiles to nothing
        when disabled.

endmenu
```

## common/xprs_ota/Kconfig
```kconfig
menu "XPRS firmware updates"

config XPRS_OTA_PULL
    bool "Let the station fetch its own image over HTTP"
    default y
    help
        With this on, the station can be told a channel or a URL and will
        go and get the image itself (cmd:update with no bytes attached).
        That convenience costs static RAM: esp_http_client and the TLS
        stack it drags in are linked in permanently, whether an update is
        running or not.

        Measured on the T-Dongle-S3, which lives at roughly 13 KB free
        with the radios up, that cost is enough to leave the HTTP server
        unable to start at boot. Turn this off on such a board: the push
        door (POST /api/update, and the mesh lane behind it) still works,
        so the image is carried to the station instead of fetched by it.
        docs/device.md section 6 states the rule and the number.

endmenu
```
